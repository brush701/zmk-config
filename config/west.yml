## config/west.yml
```yaml
manifest:
  remotes:
    - name: zmkfirmware
      url-base: https://github.com/zmkfirmware
    - name: mouse
      url-base: https://github.com/DelusionalLogic
  projects:
    - name: zmk
      #remote: zmkfirmware
      #revision: main
      remote: mouse
      revision: mouse0buttons
      import: app/west.yml
  self:
    path: config
```
